## arch/arm/mach-semidrive/Kconfig
```kconfig
if ARCH_SEMIDRIVE

config SEMIDRIVE_COMMON
	bool
	select CLK
	select DM
	select DM_SERIAL
	select SYSCON
	select REGMAP
	select PWRSEQ
	select MMC_PWRSEQ
	select BOARD_LATE_INIT
	select SYSCOUNTER_TIMER
	select SUPPORT_SPL
	imply SYS_NS16550
	imply CMD_DM

config SYSCOUNTER_TIMER
	bool

choice
	prompt "Platform select"
	default SEMIDRIVE_D9_SERIES

config SEMIDRIVE_D9_SERIES
	bool "d9 series chips"
	select ARM64
	select SEMIDRIVE_COMMON
	help
	  Select this if your SoC is an d9 d9lite d9plus

endchoice

config SYS_MALLOC_F_LEN
	default 0x1000

source "arch/arm/mach-semidrive/d9/Kconfig"

endif
```

## arch/arm/mach-semidrive/d9/Kconfig
```kconfig
if SEMIDRIVE_D9_SERIES

config SYS_SOC
	default "d9"

choice
	prompt "semidrive D9 series board select"

config TARGET_D9_REF
	bool "d9-std reference board"
	help
	    d9_ref is a reference board for d9340 SoC chip

config TARGET_D9LITE_REF
	bool "d9-lite reference board"
	help
	    d9lite_ref is a reference board for d9310 SoC chip

config TARGET_d9PLUS_AP1_REF
	bool "d9-plus reference board for ap1 cluster"
	help
	    d9plus_ap1 is a reference board for ap1 cluter in
	    the d9350 SoC chip

config TARGET_D9PLUS_AP2_REF
	bool "d9-plus reference board for ap2 cluster"
	help
	    d9plus_ap2 is a reference board for ap2 cluter in
	    the d9350 SoC chip
endchoice

source "board/semidrive/d9_ref/Kconfig"
source "board/semidrive/d9lite_ref/Kconfig"
source "board/semidrive/d9plus_ap1_ref/Kconfig"
source "board/semidrive/d9plus_ap2_ref/Kconfig"

endif
```

## board/semidrive/d9_ref/Kconfig
```kconfig
if TARGET_D9_REF

config SYS_VENDOR
	string "Vendor name"
	default "semidrive"
	help
	  This option contains information about board name.
	  Based on this option board/<CONFIG_SYS_VENDOR>/<CONFIG_SYS_BOARD> will
	  be used.

config SYS_BOARD
	string "Board name"
	default "d9_ref"
	help
	  This option contains information about board name.
	  Based on this option board/<CONFIG_SYS_VENDOR>/<CONFIG_SYS_BOARD>.c will
	  be used.

config SYS_CONFIG_NAME
	string "Board configuration name"
	default "d9_ref"
	help
	  This option contains information about board configuration name.
	  Based on this option include/configs/<CONFIG_SYS_CONFIG_NAME>.h header
	  will be used for board configuration.
endif
```

## board/semidrive/d9_ref/d9_fdt.its
```
/*
 * D9_Ref U-Boot uImage source file containing a single kernel and FDT blob
 */

/dts-v1/;

/ {
	description = "Simple image with single Linux kernel and FDT blob";
	#address-cells = <1>;

	images {
		kernel {
			description = "d9_ref Linux kernel";
			data = /incbin/("./Image.gz");
			type = "kernel";
			arch = "arm64";
			os = "linux";
			compression = "gzip";
			load = <0x57480000>;
			entry = <0x57480000>;
			hash-1 {
				algo = "crc32";
			};
			hash-2 {
				algo = "sha1";
			};
		};
		fdt-1 {
			description = "Flattened Device Tree blob";
			data = /incbin/("./d9_std_d9340_ref.dtb");
			type = "flat_dt";
			arch = "arm64";
			compression = "none";
			hash-1 {
				algo = "crc32";
			};
			hash-2 {
				algo = "sha1";
			};
		};
	};

	configurations {
		default = "conf@1";
		conf@1 {
			description = "Boot Linux kernel with FDT blob";
			kernel = "kernel";
			fdt = "fdt-1";
			compatible = "d9_ref,safety_boot";
		};
		conf@2 {
			description = "Boot Linux kernel without FDT blob";
			kernel = "kernel";
			compatible = "d9_ref,emmc_boot";
		};
	};
};
```

## board/semidrive/d9plus_ap1_ref/d9plus_ap1_fdt.its
```
/*
 * D9PLUS_AP1_Ref U-Boot uImage source file containing a single kernel and FDT blob
 */

/dts-v1/;

/ {
	description = "Simple image with single Linux kernel and FDT blob";
	#address-cells = <1>;

	images {
		kernel {
			description = "d9plus_ap1_ref Linux kernel";
			data = /incbin/("./Image.gz");
			type = "kernel";
			arch = "arm64";
			os = "linux";
			compression = "gzip";
			load = <0x57A80000>;
			entry = <0x57A80000>;
			hash-1 {
				algo = "crc32";
			};
			hash-2 {
				algo = "sha1";
			};
		};
		fdt-1 {
			description = "Flattened Device Tree blob";
			data = /incbin/("./d9_plus_d9350_ap1_ref.dtb");
			type = "flat_dt";
			arch = "arm64";
			compression = "none";
			load = <0x57800000>;
			entry = <0x57800000>;
			hash-1 {
				algo = "crc32";
			};
			hash-2 {
				algo = "sha1";
			};
		};
	};

	configurations {
		default = "conf@1";
		conf@1 {
			description = "Boot Linux kernel with FDT blob";
			kernel = "kernel";
			fdt = "fdt-1";
			compatible = "d9plus_ap1_ref,safety_boot";
		};
		conf@2 {
			description = "Boot Linux kernel without FDT blob";
			kernel = "kernel";
			compatible = "d9plus_ap1_ref,emmc_boot";
		};
	};
};
```

## configs/d9_std_defconfig
```kconfig
CONFIG_ARM=y
CONFIG_ARM_SMCCC=y
CONFIG_ARCH_SEMIDRIVE=y
CONFIG_SYS_TEXT_BASE=0x5B600000
CONFIG_NR_DRAM_BANKS=2
CONFIG_ENV_SIZE=0x10000
CONFIG_ENV_OFFSET=0x0
CONFIG_DM_GPIO=y
CONFIG_DEBUG_UART_BASE=0x30520000
CONFIG_DEBUG_UART_CLOCK=60000000
CONFIG_IDENT_STRING=" d9_ref"
# CONFIG_PSCI_RESET is not set
CONFIG_DEFAULT_DEVICE_TREE="d9_std_d9340_ref"
CONFIG_DEBUG_UART=y
CONFIG_FIT=y
CONFIG_FIT_VERBOSE=y
CONFIG_OF_BOARD_SETUP=y
CONFIG_USE_BOOTARGS=y
CONFIG_BOOTARGS="skip_initramfs noinitrd root=/dev/mmcblk0p29 rootfstype=ext4 rootwait rw init=/sbin/init highres=1 earlycon loglevel=8 nr_uarts=16 console=ttyS0,115200n8 fbcon=map:1 androidboot.mode=normal androidboot.selinux=permissive androidboot.debuggable=1 androidboot.dm_verity=disable psplash=false"
# CONFIG_USE_BOOTCOMMAND is not set
CONFIG_USE_PREBOOT=y
# CONFIG_DISPLAY_CPUINFO is not set
CONFIG_MISC_INIT_R=y
# CONFIG_CMD_BDI is not set
# CONFIG_CMD_IMI is not set
CONFIG_CMD_GPIO=y
CONFIG_CMD_GPT=y
CONFIG_CMD_I2C=y
# CONFIG_CMD_LOADS is not set
CONFIG_CMD_MMC=y
CONFIG_CMD_MTD=y
CONFIG_CMD_SPI=y
CONFIG_DEFAULT_SPI_MODE=0x3
CONFIG_CMD_WDT=y
# CONFIG_CMD_SETEXPR is not set
CONFIG_CMD_EXT4_WRITE=y
CONFIG_OF_CONTROL=y
CONFIG_ENV_IS_IN_MMC=y
CONFIG_SYS_RELOC_GD_ENV_ADDR=y
CONFIG_BOUNCE_BUFFER=y
CONFIG_SEMIDRIVE_GPIO=y
CONFIG_DM_I2C=y
CONFIG_SYS_I2C_DW=y
# CONFIG_INPUT is not set
CONFIG_DM_MMC=y
CONFIG_MMC_IO_VOLTAGE=y
CONFIG_MMC_UHS_SUPPORT=y
CONFIG_MMC_HS400_SUPPORT=y
CONFIG_MMC_SDHCI=y
CONFIG_MMC_SDHCI_ADMA=y
CONFIG_MMC_SDHCI_DWCMSHC=y
CONFIG_MMC_SDRV=y
CONFIG_MTD=y
CONFIG_DM_MTD=y
CONFIG_DM_SPI_FLASH=y
CONFIG_SPI_FLASH_GIGADEVICE=y
CONFIG_SPI_FLASH_WINBOND=y
CONFIG_SPI_FLASH_MTD=y
CONFIG_DEBUG_UART_ANNOUNCE=y
CONFIG_DEBUG_UART_SKIP_INIT=y
CONFIG_KUNLUN_SERIAL=y
CONFIG_SPI=y
CONFIG_DM_SPI=y
CONFIG_CADENCE_QSPI=y
CONFIG_SDRV_OSPI=y
CONFIG_DESIGNWARE_SPI=y
CONFIG_SDRV_DW_SPI=y
CONFIG_WDT=y
CONFIG_WDT_SEMIDRIVE=y
CONFIG_IRQCHIP=y
CONFIG_ARM_GIC=y
CONFIG_OF_LIBFDT_OVERLAY=y
```

## configs/d9plus_ap1_defconfig
```kconfig
CONFIG_ARM=y
CONFIG_ARM_SMCCC=y
CONFIG_ARCH_SEMIDRIVE=y
CONFIG_SPL_LDSCRIPT="arch/arm/mach-semidrive/u-boot-spl.lds"
CONFIG_SYS_TEXT_BASE=0x5BC00000
CONFIG_SPL_GPIO_SUPPORT=y
CONFIG_SPL_LIBCOMMON_SUPPORT=y
CONFIG_SPL_LIBGENERIC_SUPPORT=y
CONFIG_NR_DRAM_BANKS=3
CONFIG_ENV_SIZE=0x10000
CONFIG_ENV_OFFSET=0x0
CONFIG_DM_GPIO=y
CONFIG_SPL_TEXT_BASE=0x59800000
CONFIG_TARGET_D9PLUS_AP1_REF=y
CONFIG_SPL_MMC_SUPPORT=y
CONFIG_SPL_SYS_MALLOC_F_LEN=0x200000
CONFIG_SPL_SIZE_LIMIT=0x400000
CONFIG_SPL=y
CONFIG_IDENT_STRING=" d9plus_ap1_ref"
CONFIG_SPL_LIBDISK_SUPPORT=y
CONFIG_ARMV8_SPL_EXCEPTION_VECTORS=y
# CONFIG_PSCI_RESET is not set
CONFIG_DEFAULT_DEVICE_TREE="d9_plus_d9350_ap1_ref"
CONFIG_FIT=y
CONFIG_FIT_VERBOSE=y
CONFIG_OF_BOARD_SETUP=y
CONFIG_USE_BOOTARGS=y
CONFIG_BOOTARGS="skip_initramfs noinitrd root=/dev/mmcblk0p43 rootfstype=ext4 rootwait rw init=/sbin/init highres=1 earlycon loglevel=8 nr_uarts=16 console=ttyS0,115200n8 fbcon=map:1 androidboot.mode=normal androidboot.selinux=permissive androidboot.debuggable=1 androidboot.dm_verity=disable psplash=false"
# CONFIG_USE_BOOTCOMMAND is not set
CONFIG_USE_PREBOOT=y
# CONFIG_DISPLAY_CPUINFO is not set
CONFIG_MISC_INIT_R=y
CONFIG_SPL_FRAMEWORK_BOARD_INIT_F=y
CONFIG_SPL_SIZE_LIMIT_SUBTRACT_GD=y
CONFIG_SPL_SEPARATE_BSS=y
CONFIG_SPL_DISPLAY_PRINT=y
CONFIG_SPL_FS_EXT4=y
CONFIG_SPL_MMC_WRITE=y
# CONFIG_CMD_BDI is not set
# CONFIG_CMD_IMI is not set
CONFIG_CMD_GPIO=y
CONFIG_CMD_GPT=y
CONFIG_CMD_I2C=y
# CONFIG_CMD_LOADS is not set
CONFIG_CMD_MMC=y
CONFIG_CMD_MTD=y
CONFIG_CMD_SPI=y
CONFIG_DEFAULT_SPI_MODE=0x3
CONFIG_CMD_WDT=y
# CONFIG_CMD_SETEXPR is not set
CONFIG_CMD_EXT4_WRITE=y
# CONFIG_SPL_DOS_PARTITION is not set
CONFIG_OF_CONTROL=y
CONFIG_SPL_OF_CONTROL=y
CONFIG_OF_SPL_REMOVE_PROPS=""
CONFIG_ENV_IS_IN_MMC=y
CONFIG_SYS_RELOC_GD_ENV_ADDR=y
CONFIG_SPL_DM=y
CONFIG_SPL_DM_WARN=y
CONFIG_SPL_DM_DEVICE_REMOVE=y
CONFIG_SPL_DM_SEQ_ALIAS=y
CONFIG_SPL_REGMAP=y
CONFIG_SPL_SYSCON=y
CONFIG_SPL_OF_TRANSLATE=y
CONFIG_BOUNCE_BUFFER=y
CONFIG_SPL_BLOCK_CACHE=y
CONFIG_SEMIDRIVE_GPIO=y
CONFIG_DM_I2C=y
CONFIG_SYS_I2C_DW=y
# CONFIG_INPUT is not set
CONFIG_DM_MMC=y
CONFIG_MMC_IO_VOLTAGE=y
CONFIG_MMC_UHS_SUPPORT=y
CONFIG_MMC_HS400_SUPPORT=y
CONFIG_SPL_MMC_HS400_SUPPORT=y
CONFIG_MMC_SDHCI=y
CONFIG_MMC_SDHCI_ADMA=y
CONFIG_MMC_SDHCI_DWCMSHC=y
CONFIG_MMC_SDRV=y
CONFIG_MTD=y
CONFIG_DM_MTD=y
CONFIG_DM_SPI_FLASH=y
CONFIG_SPI_FLASH_GIGADEVICE=y
CONFIG_SPI_FLASH_WINBOND=y
CONFIG_SPI_FLASH_MTD=y
# CONFIG_SYS_NS16550 is not set
CONFIG_SEMIDRIVE_SERIAL=y
CONFIG_SPI=y
CONFIG_DM_SPI=y
CONFIG_CADENCE_QSPI=y
CONFIG_SDRV_OSPI=y
CONFIG_DESIGNWARE_SPI=y
CONFIG_SDRV_DW_SPI=y
CONFIG_WDT=y
CONFIG_WDT_SEMIDRIVE=y
CONFIG_IRQCHIP=y
CONFIG_ARM_GIC=y
CONFIG_OF_LIBFDT_OVERLAY=y
```

## configs/d9plus_ap2_defconfig
```kconfig
CONFIG_ARM=y
CONFIG_ARM_SMCCC=y
CONFIG_ARCH_SEMIDRIVE=y
CONFIG_SPL_LDSCRIPT="arch/arm/mach-semidrive/u-boot-spl.lds"
CONFIG_SYS_TEXT_BASE=0x8A200000
CONFIG_SPL_GPIO_SUPPORT=y
CONFIG_SPL_LIBCOMMON_SUPPORT=y
CONFIG_SPL_LIBGENERIC_SUPPORT=y
CONFIG_NR_DRAM_BANKS=2
CONFIG_ENV_SIZE=0x10000
CONFIG_DM_GPIO=y
CONFIG_SPL_TEXT_BASE=0x87E00000
CONFIG_TARGET_D9PLUS_AP2_REF=y
CONFIG_SPL_SERIAL_SUPPORT=y
CONFIG_SPL_SYS_MALLOC_F_LEN=0x200000
CONFIG_SPL_SIZE_LIMIT=0x400000
CONFIG_SPL=y
CONFIG_DEBUG_UART_BASE=0x304D0000
CONFIG_DEBUG_UART_CLOCK=60000000
CONFIG_IDENT_STRING=" d9plus_ap2_ref"
CONFIG_ARMV8_SPL_EXCEPTION_VECTORS=y
# CONFIG_PSCI_RESET is not set
CONFIG_DEFAULT_DEVICE_TREE="d9_plus_d9350_ap2_ref"
CONFIG_DEBUG_UART=y
CONFIG_FIT=y
CONFIG_FIT_VERBOSE=y
CONFIG_OF_BOARD_SETUP=y
CONFIG_USE_BOOTARGS=y
CONFIG_BOOTARGS="root=/dev/ram0 rootfstype=ramfs highres=1 nr_cpus=1 loglevel=4 console=ttyS0,115200n8 fbcon=map:1 androidboot.mode=normal androidboot.selinux=permissive androidboot.debuggable=1 androidboot.dm_verity=disable psplash=false init=/init"
# CONFIG_USE_BOOTCOMMAND is not set
CONFIG_USE_PREBOOT=y
# CONFIG_DISPLAY_CPUINFO is not set
CONFIG_MISC_INIT_R=y
CONFIG_SPL_FRAMEWORK_BOARD_INIT_F=y
CONFIG_SPL_SIZE_LIMIT_SUBTRACT_GD=y
CONFIG_SPL_SEPARATE_BSS=y
CONFIG_SPL_DISPLAY_PRINT=y
# CONFIG_CMD_BDI is not set
# CONFIG_CMD_IMI is not set
CONFIG_CMD_GPIO=y
CONFIG_CMD_GPT=y
CONFIG_CMD_I2C=y
# CONFIG_CMD_LOADS is not set
CONFIG_CMD_SPI=y
CONFIG_DEFAULT_SPI_MODE=0x3
CONFIG_CMD_WDT=y
# CONFIG_CMD_SETEXPR is not set
CONFIG_CMD_EXT4_WRITE=y
# CONFIG_SPL_DOS_PARTITION is not set
CONFIG_OF_CONTROL=y
CONFIG_SPL_OF_CONTROL=y
CONFIG_OF_SPL_REMOVE_PROPS=""
CONFIG_SYS_RELOC_GD_ENV_ADDR=y
CONFIG_SPL_DM=y
CONFIG_SPL_DM_WARN=y
CONFIG_SPL_DM_DEVICE_REMOVE=y
CONFIG_SPL_DM_SEQ_ALIAS=y
CONFIG_SPL_REGMAP=y
CONFIG_SPL_SYSCON=y
CONFIG_SPL_OF_TRANSLATE=y
CONFIG_BOUNCE_BUFFER=y
CONFIG_SEMIDRIVE_GPIO=y
CONFIG_DM_I2C=y
CONFIG_SYS_I2C_DW=y
# CONFIG_INPUT is not set
# CONFIG_MMC is not set
CONFIG_DEBUG_UART_ANNOUNCE=y
CONFIG_DEBUG_UART_SKIP_INIT=y
# CONFIG_SYS_NS16550 is not set
CONFIG_SEMIDRIVE_SERIAL=y
CONFIG_SPI=y
CONFIG_DM_SPI=y
CONFIG_DESIGNWARE_SPI=y
CONFIG_SDRV_DW_SPI=y
CONFIG_WDT=y
CONFIG_WDT_SEMIDRIVE=y
CONFIG_IRQCHIP=y
CONFIG_ARM_GIC=y
CONFIG_OF_LIBFDT_OVERLAY=y
```

## drivers/irqchip/Kconfig
```kconfig
menu "Irqchip Support"

config IRQCHIP
	bool "Enable driver model for irqchip drivers"
	depends on DM
	help
	  Enable driver model for irqchip access.

config ARM_GIC
	bool "ARM gicv2 support"
	depends on IRQCHIP
	help
	  Select this to enable support for the gic controller.

config NR_IRQS
	int "Maximum number of IRQs (0-1024)"
	range 0 1024
	default "1024"

endmenu
```

## drivers/phy/semidrive/Kconfig
```kconfig
#
# Phy drivers for semidrive platforms
#
config PHY_SEMIDRIVE_USB
	tristate "Semidrive USB PHY Driver"
	depends on ARCH_SEMIDRIVE
	select PHY
	help
	  Support USB3.0 PHY with synopsys IP block
```
